## ZephyrDemo/build_1/Kconfig/arch/Kconfig
```kconfig
# Load Zephyr Arch Kconfig descriptions.
osource "/home/johan/ncs/v3.2.1/zephyr/arch/rx/Kconfig"
osource "/home/johan/ncs/v3.2.1/zephyr/arch/x86/Kconfig"
osource "/home/johan/ncs/v3.2.1/zephyr/arch/xtensa/Kconfig"
osource "/home/johan/ncs/v3.2.1/zephyr/arch/sparc/Kconfig"
osource "/home/johan/ncs/v3.2.1/zephyr/arch/riscv/Kconfig"
osource "/home/johan/ncs/v3.2.1/zephyr/arch/posix/Kconfig"
osource "/home/johan/ncs/v3.2.1/zephyr/arch/mips/Kconfig"
osource "/home/johan/ncs/v3.2.1/zephyr/arch/arm64/Kconfig"
osource "/home/johan/ncs/v3.2.1/zephyr/arch/arm/Kconfig"
osource "/home/johan/ncs/v3.2.1/zephyr/arch/arc/Kconfig"
```

## ZephyrDemo/build_1/Kconfig/boards/Kconfig.defconfig
```kconfig
# Load Zephyr board defconfig descriptions.
osource "/home/johan/ncs/v3.2.1/zephyr/boards/nordic/nrf52dk/Kconfig.defconfig"
```

## ZephyrDemo/build_1/ZephyrDemo/Kconfig/boards/Kconfig.nrf52dk
```kconfig
# Load board Kconfig descriptions.
osource "/home/johan/ncs/v3.2.1/zephyr/boards/nordic/nrf52dk/Kconfig.nrf52dk"
```
