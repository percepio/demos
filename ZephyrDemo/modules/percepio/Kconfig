## ZephyrDemo/modules/percepio/Kconfig
```kconfig
# Copyright (c) 2023 Percepio AB
# SPDX-License-Identifier: Apache-2.0

if PERCEPIO_TRACERECORDER
menu "Percepio TraceRecorder configuration"
rsource "../../../PercepioLibs/TraceRecorder/kernelports/Zephyr/Kconfig"
endmenu
endif

if !PERCEPIO_DFM
config PERCEPIO_DFM_STUB_INCLUDED
	bool "Include Percepio Detect (DFM) stub API"
	default n
endif

config PERCEPIO_DFM
	bool "Percepio Detect (DFM) support"
	default n

if PERCEPIO_DFM
menu "Detect"
rsource "../../../PercepioLibs/DFM/kernelports/Zephyr/Kconfig"
endmenu
endif
```
